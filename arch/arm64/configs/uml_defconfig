## arch/arm64/configs/uml_defconfig
```kconfig
# UML-on-arm64 defconfig
CONFIG_UML=y
CONFIG_64BIT=y
CONFIG_MMU=y
CONFIG_BINFMT_ELF=y
CONFIG_BINFMT_SCRIPT=y
CONFIG_TTY=y
CONFIG_PRINTK=y
CONFIG_PROC_FS=y
CONFIG_SYSFS=y
CONFIG_BLOCK=y
# CONFIG_SUSPEND is not set
CONFIG_ARM64_4K_PAGES=y
# CONFIG_ARM64_VA_BITS_52 is not set
CONFIG_ARM64_VA_BITS_48=y
CONFIG_ARM64_PA_BITS_48=y
# CONFIG_ARM64_LPA2 is not set
```

## arch/arm64/um/Kconfig
```kconfig
# SPDX-License-Identifier: GPL-2.0

config UML_ARM64
	def_bool y
	select 64BIT
	select ARCH_USE_QUEUED_RWLOCKS
	select ARCH_SUPPORTS_ATOMIC_RMW
	select ARCH_USE_QUEUED_SPINLOCKS
	select DCACHE_WORD_ACCESS
	select HAVE_EFFICIENT_UNALIGNED_ACCESS
	select UML_SUBARCH_SUPPORTS_SMP
	select MODULES_USE_ELF_RELA
	select GENERIC_HWEIGHT
	select ARCH_WANT_DEFAULT_TOPDOWN_MMAP_LAYOUT if !COMPAT
	select HAVE_ARCH_MMAP_RND_BITS
	select GENERIC_CSUM
	select CLONE_BACKWARDS

# Arm64 UML is always 64-bit
config 64BIT
	bool
	default y

config PGTABLE_LEVELS
	int
	default 4

config ARCH_MMAP_RND_BITS_MIN
	int
	default 18

config ARCH_MMAP_RND_BITS_MAX
	int
	default 33

config ARCH_MMAP_RND_BITS
	int
	default 18

config ARCH_HAS_SC_SIGNALS
	def_bool n

config GENERIC_HWEIGHT
	def_bool y

config GENERIC_CSUM
	def_bool y
```
